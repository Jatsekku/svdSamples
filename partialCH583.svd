# CH583SFR register map
Vendor: WCH Ltd.; Series: CH58x; File version: 1.0
WCH wireless MCU CH58x Family Support, Drivers
Registers are 8-bit, read-write, reset 0x2 unless marked. A register's access mark holds for its fields unless they carry their own. Offsets are from the block's base; lines under a group give offsets from that group; [hi:lo] are bit positions; {n}, {i} and the like mark numbered series; 'fields as' and 'values as' point back to an identical list; <NAME> marks a mode.

## Memory map
0x40002000 TMR0 size 0x400 — Timer0 register

## Interrupts
16 TMR0

## TMR0 — Timer0 register
Base 0x40002000
0x03 CTRL_MOD
0x03 INTER_EN
0x32 INT_FLAG
